## linux-6.6/bsp/configs/linux-5.4-ansc/sun300iw1_memopt_defconfig
```kconfig
# CONFIG_LOCALVERSION_AUTO is not set
CONFIG_SYSVIPC=y
CONFIG_POSIX_MQUEUE=y
CONFIG_NO_HZ_IDLE=y
CONFIG_HIGH_RES_TIMERS=y
CONFIG_PREEMPT=y
CONFIG_IKCONFIG=y
CONFIG_IKCONFIG_PROC=y
CONFIG_LOG_BUF_SHIFT=15
CONFIG_NAMESPACES=y
CONFIG_USER_NS=y
CONFIG_CHECKPOINT_RESTORE=y
CONFIG_CC_OPTIMIZE_FOR_SIZE=y
CONFIG_EXPERT=y
# CONFIG_KALLSYMS is not set
CONFIG_BPF_SYSCALL=y
# CONFIG_SLUB_DEBUG is not set
CONFIG_ARCH_RV32I=y
# CONFIG_PMA is not set
CONFIG_HZ_1000=y
CONFIG_CMDLINE="earlyprintk=sunxi-uart,0x42500000 loglevel=8 initcall_debug=1 console=ttyAS0 init=/init"
CONFIG_MODULES=y
CONFIG_MODULE_UNLOAD=y
CONFIG_AW_BSP=y
CONFIG_AW_KERNEL_ORIGIN=y
CONFIG_AW_IC_BOARD=y
CONFIG_AW_SOC_NAME="v821"
# CONFIG_AW_DDR_CCU is not set
# CONFIG_AW_CCMU_DYNAMIC_DEBUG is not set
# CONFIG_AW_PINCTRL_DYNAMIC_DEBUG is not set
# CONFIG_AW_UART_DYNAMIC_DEBUG is not set
CONFIG_AW_DMA=y
CONFIG_AW_RTC=y
CONFIG_AW_RTC_REBOOT_FLAG=y
CONFIG_AW_RTC_POWEROFF_ALARM=y
# CONFIG_AW_DUMPREG_DYNAMIC_DEBUG is not set
CONFIG_AW_WATCHDOG=y
CONFIG_AW_MBUS_GENERIC=y
CONFIG_AW_MMC_HSQ=y
CONFIG_AW_MMC=y
CONFIG_AW_MTD=y
CONFIG_AW_MTD_SUNXI_PARTS=y
CONFIG_AW_MTD_SPI_NOR_5_4=y
# CONFIG_MTD_SPI_NOR_USE_4K_SECTORS is not set
CONFIG_SPIF_SUNXI=y
CONFIG_AW_VIDEO_SUNXI_VIN=m
CONFIG_ENABLE_SENSOR_FLIP_OPTION=y
# CONFIG_FLASH is not set
# CONFIG_SENSOR_LIST is not set
CONFIG_VIN_USE_ION_SIZE_POOL_HEAP=y
CONFIG_D3D=y
# CONFIG_SAME_I2C is not set
CONFIG_SENSOR_GC1084_MIPI=m
# CONFIG_AW_VIDEO_DYNAMIC_DEBUG is not set
CONFIG_SND_SOC_SUNXI_AAUDIO=y
CONFIG_SND_SOC_SUNXI_I2S=y
# CONFIG_SND_SOC_SUNXI_DYNAMIC_DEBUG is not set
CONFIG_AW_SYS_INFO=y
CONFIG_AW_SID=y
CONFIG_AW_GMAC=y
CONFIG_USB_EHCI_HCD_SUNXI=y
CONFIG_USB_OHCI_HCD_SUNXI=y
CONFIG_USB_SUNXI_HCD=y
CONFIG_USB_SUNXI_HCI=y
CONFIG_USB_SUNXI_EHCI0=y
CONFIG_USB_SUNXI_OHCI0=y
CONFIG_USB_SUNXI_USB=y
CONFIG_USB_SUNXI_USB_MANAGER=y
CONFIG_USB_SUNXI_USB_ADB=y
CONFIG_USB_SUNXI_UDC0=y
CONFIG_AW_TWI=y
CONFIG_AW_TWI_DYNAMIC_DEBUG=y
CONFIG_AW_SPI_NG=y
CONFIG_AW_SPI_NG_ATOMIC_XFER=y
CONFIG_AW_SPI_SLAVETEST=m
CONFIG_AW_SPI_CAMERATEST=m
CONFIG_AW_PWM=y
# CONFIG_AW_PWM_DYNAMIC_DEBUG is not set
CONFIG_AW_GPADC=y
# CONFIG_AW_GPADC_DYNAMIC_DEBUG is not set
CONFIG_V821_FMAC_WLAN=m
CONFIG_V821_FMAC_RPMSG=m
CONFIG_AW_REGULATOR_SOC_PMU=y
CONFIG_AW_RISCV_SUSPEND=y
CONFIG_AW_MSGBOX=y
CONFIG_AW_HWSPINLOCK=y
CONFIG_AW_REMOTEPROC=y
# CONFIG_AW_RPMSG_RX_IN_KTHREAD is not set
CONFIG_SUNXI_RPROC_SHARE_IRQ=y
CONFIG_AW_REMOTEPROC_E907_BOOT=y
CONFIG_AW_RPMSG_CTRL=y
CONFIG_AW_RPMSG_HEARTBEAT=y
CONFIG_AW_RPBUF_SERVICE_RPMSG=y
CONFIG_AW_RPBUF_CONTROLLER_SUNXI=y
CONFIG_AW_MACADDR_MGT=y
CONFIG_AW_ANDES_DMA_ADAPT=y
CONFIG_ION_SIZE_POOL_HEAP=y
CONFIG_CMA=y
CONFIG_NET=y
CONFIG_PACKET=y
CONFIG_UNIX=y
CONFIG_UNIX_DIAG=y
CONFIG_NET_KEY=y
CONFIG_INET=y
CONFIG_IP_MULTICAST=y
CONFIG_IP_ADVANCED_ROUTER=y
CONFIG_IP_FIB_TRIE_STATS=y
CONFIG_IP_MULTIPLE_TABLES=y
CONFIG_IP_PNP=y
CONFIG_IP_PNP_DHCP=y
CONFIG_IP_PNP_BOOTP=y
CONFIG_IP_PNP_RARP=y
# CONFIG_INET_DIAG is not set
CONFIG_NETLINK_DIAG=y
CONFIG_NET_9P=y
CONFIG_NET_9P_VIRTIO=y
CONFIG_FAILOVER=y
CONFIG_DEVTMPFS=y
CONFIG_DEVTMPFS_MOUNT=y
CONFIG_MTD=y
CONFIG_MTD_BLOCK=y
CONFIG_BLK_DEV_LOOP=y
CONFIG_VIRTIO_BLK=y
# CONFIG_NET_VENDOR_ALACRITECH is not set
# CONFIG_NET_VENDOR_AMAZON is not set
# CONFIG_NET_VENDOR_AQUANTIA is not set
# CONFIG_NET_VENDOR_ARC is not set
# CONFIG_NET_VENDOR_AURORA is not set
# CONFIG_NET_VENDOR_BROADCOM is not set
# CONFIG_NET_VENDOR_CADENCE is not set
# CONFIG_NET_VENDOR_CAVIUM is not set
# CONFIG_NET_VENDOR_CORTINA is not set
# CONFIG_NET_VENDOR_EZCHIP is not set
# CONFIG_NET_VENDOR_FARADAY is not set
# CONFIG_NET_VENDOR_GOOGLE is not set
# CONFIG_NET_VENDOR_HUAWEI is not set
# CONFIG_NET_VENDOR_INTEL is not set
# CONFIG_NET_VENDOR_MARVELL is not set
# CONFIG_NET_VENDOR_MELLANOX is not set
# CONFIG_NET_VENDOR_MICREL is not set
# CONFIG_NET_VENDOR_MICROCHIP is not set
# CONFIG_NET_VENDOR_MICROSEMI is not set
# CONFIG_NET_VENDOR_NATSEMI is not set
# CONFIG_NET_VENDOR_NETRONOME is not set
# CONFIG_NET_VENDOR_NI is not set
# CONFIG_NET_VENDOR_PENSANDO is not set
# CONFIG_NET_VENDOR_QUALCOMM is not set
# CONFIG_NET_VENDOR_RENESAS is not set
# CONFIG_NET_VENDOR_ROCKER is not set
# CONFIG_NET_VENDOR_SAMSUNG is not set
# CONFIG_NET_VENDOR_SEEQ is not set
# CONFIG_NET_VENDOR_SOLARFLARE is not set
# CONFIG_NET_VENDOR_SOCIONEXT is not set
# CONFIG_NET_VENDOR_STMICRO is not set
# CONFIG_NET_VENDOR_SYNOPSYS is not set
# CONFIG_NET_VENDOR_VIA is not set
# CONFIG_NET_VENDOR_WIZNET is not set
# CONFIG_WLAN_VENDOR_ADMTEK is not set
# CONFIG_WLAN_VENDOR_ATH is not set
# CONFIG_WLAN_VENDOR_ATMEL is not set
# CONFIG_WLAN_VENDOR_BROADCOM is not set
# CONFIG_WLAN_VENDOR_CISCO is not set
# CONFIG_WLAN_VENDOR_INTEL is not set
# CONFIG_WLAN_VENDOR_INTERSIL is not set
# CONFIG_WLAN_VENDOR_MARVELL is not set
# CONFIG_WLAN_VENDOR_MEDIATEK is not set
# CONFIG_WLAN_VENDOR_RALINK is not set
# CONFIG_WLAN_VENDOR_REALTEK is not set
# CONFIG_WLAN_VENDOR_RSI is not set
# CONFIG_WLAN_VENDOR_ST is not set
# CONFIG_WLAN_VENDOR_TI is not set
# CONFIG_WLAN_VENDOR_ZYDAS is not set
# CONFIG_WLAN_VENDOR_QUANTENNA is not set
# CONFIG_INPUT_KEYBOARD is not set
# CONFIG_INPUT_MOUSE is not set
# CONFIG_SERIO is not set
# CONFIG_VT is not set
# CONFIG_UNIX98_PTYS is not set
# CONFIG_LEGACY_PTYS is not set
# CONFIG_LDISC_AUTOLOAD is not set
CONFIG_SERIAL_EARLYCON_RISCV_SBI=y
CONFIG_HVC_RISCV_SBI=y
CONFIG_VIRTIO_CONSOLE=y
CONFIG_HW_RANDOM=y
CONFIG_HW_RANDOM_VIRTIO=y
CONFIG_SPI_SPIDEV=y
CONFIG_POWER_SUPPLY=y
CONFIG_MEDIA_SUPPORT=y
CONFIG_MEDIA_CAMERA_SUPPORT=y
CONFIG_MEDIA_CONTROLLER=y
CONFIG_VIDEO_V4L2_SUBDEV_API=y
CONFIG_V4L_PLATFORM_DRIVERS=y
CONFIG_BACKLIGHT_CLASS_DEVICE=y
CONFIG_SOUND=y
CONFIG_SND=y
CONFIG_SND_SOC=y
# CONFIG_USB_HID is not set
CONFIG_USB=y
CONFIG_USB_ANNOUNCE_NEW_DEVICES=y
CONFIG_USB_XHCI_HCD=y
CONFIG_USB_XHCI_PLATFORM=y
CONFIG_USB_EHCI_HCD=y
CONFIG_USB_EHCI_HCD_PLATFORM=y
CONFIG_USB_OHCI_HCD=y
CONFIG_USB_OHCI_HCD_PLATFORM=y
CONFIG_USB_GADGET=y
CONFIG_USB_CONFIGFS=y
CONFIG_USB_CONFIGFS_MASS_STORAGE=y
CONFIG_USB_CONFIGFS_F_FS=y
CONFIG_USB_ROLE_SWITCH=y
CONFIG_MMC=y
CONFIG_SYNC_FILE=y
CONFIG_VIRTIO_BALLOON=y
CONFIG_VIRTIO_INPUT=y
CONFIG_VIRTIO_MMIO=y
CONFIG_STAGING=y
CONFIG_ION=y
CONFIG_ION_CMA_HEAP=y
CONFIG_SIFIVE_PLIC=y
CONFIG_RAS=y
CONFIG_ANDROID=y
CONFIG_EXT4_FS=y
CONFIG_EXT4_FS_POSIX_ACL=y
CONFIG_AUTOFS4_FS=y
CONFIG_FUSE_FS=y
CONFIG_OVERLAY_FS=y
CONFIG_MSDOS_FS=y
CONFIG_VFAT_FS=y
CONFIG_TMPFS=y
CONFIG_TMPFS_POSIX_ACL=y
CONFIG_JFFS2_FS=y
CONFIG_SQUASHFS=y
# CONFIG_SQUASHFS_ZLIB is not set
CONFIG_SQUASHFS_XZ=y
CONFIG_EROFS_FS=y
CONFIG_NFS_FS=y
CONFIG_NFS_V4=y
CONFIG_NFS_V4_1=y
CONFIG_NFS_V4_2=y
CONFIG_ROOT_NFS=y
CONFIG_9P_FS=y
CONFIG_NLS_CODEPAGE_437=y
CONFIG_NLS_ISO8859_1=y
# CONFIG_CRYPTO_HW is not set
# CONFIG_XZ_DEC_X86 is not set
# CONFIG_XZ_DEC_POWERPC is not set
# CONFIG_XZ_DEC_IA64 is not set
# CONFIG_XZ_DEC_ARM is not set
# CONFIG_XZ_DEC_ARMTHUMB is not set
# CONFIG_XZ_DEC_SPARC is not set
CONFIG_DMA_CMA=y
CONFIG_PRINTK_TIME=y
# CONFIG_DEBUG_FS is not set
# CONFIG_DEBUG_MISC is not set
# CONFIG_SCHED_DEBUG is not set
# CONFIG_FTRACE is not set
# CONFIG_RUNTIME_TESTING_MENU is not set
```

## linux-6.6/bsp/configs/linux-6.6-xuantie/sun20iw1p1_min_defconfig
```kconfig
CONFIG_AW_BSP=y
CONFIG_AW_KERNEL_ORIGIN=y
CONFIG_ARCH_SUN20I=y
CONFIG_AW_IC_BOARD=y
CONFIG_AW_SOC_NAME="F133"
# CONFIG_AW_DDR_CCU is not set
CONFIG_AW_SUN8IW20_CCU=y
CONFIG_AW_SUN8IW20_R_CCU=y
# CONFIG_AW_UART is not set
CONFIG_AW_UART_NG=y
CONFIG_AW_SERIAL_CONSOLE=y
CONFIG_AW_MMC_HSQ=y
CONFIG_AW_MMC=y
# CONFIG_AW_VIDEO_ENCODER_DECODER is not set
# CONFIG_AW_INPUT_SENSORINIT is not set
# CONFIG_AW_NNA_VIP is not set
# CONFIG_AW_NNA_GALCORE is not set
CONFIG_SYSVIPC=y
CONFIG_NO_HZ_IDLE=y
CONFIG_HIGH_RES_TIMERS=y
CONFIG_BPF_SYSCALL=y
CONFIG_IKCONFIG=y
CONFIG_IKCONFIG_PROC=y
CONFIG_CGROUPS=y
CONFIG_CGROUP_SCHED=y
CONFIG_CFS_BANDWIDTH=y
CONFIG_CGROUP_BPF=y
CONFIG_NAMESPACES=y
CONFIG_USER_NS=y
CONFIG_CHECKPOINT_RESTORE=y
CONFIG_BLK_DEV_INITRD=y
CONFIG_INITRAMFS_SOURCE="./../../../../bsp/ramfs/ramfs_riscv64"
CONFIG_EXPERT=y
CONFIG_JUMP_LABEL=y
CONFIG_MODULES=y
CONFIG_MODULE_UNLOAD=y
CONFIG_DEVTMPFS=y
CONFIG_DEVTMPFS_MOUNT=y
CONFIG_BLK_DEV_LOOP=y
CONFIG_VIRTIO_BLK=y
# CONFIG_INPUT_KEYBOARD is not set
# CONFIG_INPUT_MOUSE is not set
CONFIG_SERIO_LIBPS2=y
CONFIG_SERIAL_8250=y
CONFIG_VIRTIO_CONSOLE=m
# CONFIG_HW_RANDOM is not set
# CONFIG_HWMON is not set
CONFIG_MFD_SUN6I_PRCM=y
CONFIG_FB=y
CONFIG_BACKLIGHT_CLASS_DEVICE=y
CONFIG_FRAMEBUFFER_CONSOLE=y
CONFIG_FRAMEBUFFER_CONSOLE_DETECT_PRIMARY=y
# CONFIG_USB_SUPPORT is not set
CONFIG_MMC=y
CONFIG_RTC_CLASS=y
CONFIG_SYNC_FILE=y
# CONFIG_VIRTIO_MENU is not set
# CONFIG_SUNXI_CCU is not set
# CONFIG_IOMMU_SUPPORT is not set
CONFIG_RPMSG_VIRTIO=y
CONFIG_EXT4_FS=y
CONFIG_EXT4_FS_POSIX_ACL=y
CONFIG_MSDOS_FS=y
CONFIG_VFAT_FS=y
CONFIG_TMPFS=y
CONFIG_TMPFS_POSIX_ACL=y
CONFIG_NLS_CODEPAGE_437=y
CONFIG_NLS_ISO8859_1=y
CONFIG_CRYPTO_DEV_VIRTIO=y
CONFIG_CRC_ITU_T=y
CONFIG_CRC7=y
CONFIG_PRINTK_TIME=y
CONFIG_DEBUG_FS=y
```

## linux-6.6/bsp/configs/linux-6.6/android_stage1_min_ko_defconfig
```kconfig
# AW common config
CONFIG_AW_BSP=y
CONFIG_ARCH_SUN60I=y
CONFIG_ARCH_SUN60IW2=y
CONFIG_AW_IC_BOARD=y
CONFIG_AW_SOC_NAME="A733"


# AW self module config
CONFIG_AW_CCU=m
CONFIG_AW_PINCTRL=m
# CONFIG_AW_UART is not set
CONFIG_AW_UART_NG=m
CONFIG_AW_SERIAL_CONSOLE=y
CONFIG_AW_MMC_HSQ=m
CONFIG_AW_MMC=m
# CONFIG_AW_VIDEO_ENCODER_DECODER is not set
# CONFIG_AW_INPUT_SENSORINIT is not set
# CONFIG_AW_NNA_VIP is not set
# CONFIG_AW_NNA_GALCORE is not set


# linux-6.6 system common module config
CONFIG_DMABUF_HEAPS_SYSTEM=m
CONFIG_DMABUF_HEAPS_CMA=m
CONFIG_ZSMALLOC=m
```

## linux-6.6/bsp/configs/linux-6.6/android_stage2_min_ko_defconfig
```kconfig
CONFIG_AW_BSP=y
CONFIG_ARCH_SUN60I=y
CONFIG_ARCH_SUN60IW2=y
CONFIG_AW_IC_BOARD=y
CONFIG_AW_SOC_NAME="A733"
# CONFIG_AW_UART is not set
CONFIG_AW_UART_NG=y
CONFIG_AW_SERIAL_CONSOLE=y
CONFIG_AW_DMA=m
CONFIG_AW_RTC=m
CONFIG_AW_RTC_REBOOT_FLAG=y
CONFIG_AW_RTC_POWEROFF_ALARM=y
CONFIG_AW_NSI=m
CONFIG_AW_DUMP_REG=m
CONFIG_AW_WATCHDOG=m
CONFIG_AW_IOMMU=m
CONFIG_AW_MMC_HSQ=m
CONFIG_AW_MMC=m
# CONFIG_AW_VIDEO_ENCODER_DECODER is not set
CONFIG_AW_SYS_INFO=m
CONFIG_AW_SMC=m
CONFIG_AW_SID=m
CONFIG_USB_EHCI_HCD_SUNXI=m
CONFIG_USB_OHCI_HCD_SUNXI=m
CONFIG_USB_SUNXI_HCD=m
CONFIG_USB_SUNXI_HCI=m
CONFIG_USB_SUNXI_EHCI0=m
CONFIG_USB_SUNXI_EHCI1=m
CONFIG_USB_SUNXI_OHCI0=m
CONFIG_USB_SUNXI_OHCI1=m
CONFIG_USB_SUNXI_USB=m
CONFIG_USB_SUNXI_USB_MANAGER=m
CONFIG_USB_SUNXI_USB_DEBUG=m
CONFIG_USB_SUNXI_USB_ADB=m
CONFIG_USB_SUNXI_UDC0=m
CONFIG_AW_TWI=m
CONFIG_AW_LRADC=m
CONFIG_AW_WAKEUPGEN=m
CONFIG_AW_SUN8I_NMI=m
CONFIG_AW_MFD_AXP2101_I2C=m
CONFIG_AW_MFD_PMU_EXT_I2C=m
CONFIG_AW_REGULATOR_AXP2101=m
CONFIG_AW_REGULATOR_PMU_EXT=m
CONFIG_AW_INPUT_AXP2101_PEK=m
CONFIG_AW_AXP803_POWER=m
CONFIG_AW_AXP2202_POWER=m
# CONFIG_AW_NNA_VIP is not set
# CONFIG_AW_NNA_GALCORE is not set
CONFIG_USB_STORAGE_DATAFAB=m
CONFIG_USB_STORAGE_FREECOM=m
CONFIG_USB_STORAGE_ISD200=m
CONFIG_USB_STORAGE_USBAT=m
CONFIG_USB_STORAGE_SDDR09=m
CONFIG_USB_STORAGE_SDDR55=m
CONFIG_USB_STORAGE_JUMPSHOT=m
CONFIG_USB_STORAGE_ALAUDA=m
CONFIG_USB_STORAGE_KARMA=m
CONFIG_USB_STORAGE_CYPRESS_ATACB=m
CONFIG_USB_STORAGE_ENE_UB6250=m
CONFIG_USB_SERIAL_OPTION=m
CONFIG_DMABUF_HEAPS_SYSTEM=m
CONFIG_DMABUF_HEAPS_CMA=m
# CONFIG_FTRACE is not set
```

## linux-6.6/bsp/drivers/Kconfig
```kconfig
# SPDX-License-Identifier: GPL-2.0-only

menu "Device Drivers"

# Minimal System
source "$(BSP_TOP)drivers/clk/Kconfig"
source "$(BSP_TOP)drivers/pinctrl/Kconfig"
source "$(BSP_TOP)drivers/uart/Kconfig"
source "$(BSP_TOP)drivers/timer/Kconfig"

# Basic System
source "$(BSP_TOP)drivers/dma/Kconfig"
source "$(BSP_TOP)drivers/rtc/Kconfig"
source "$(BSP_TOP)drivers/bus/Kconfig"
source "$(BSP_TOP)drivers/dumpreg/Kconfig"
source "$(BSP_TOP)drivers/watchdog/Kconfig"
source "$(BSP_TOP)drivers/iommu/Kconfig"
source "$(BSP_TOP)drivers/mbus/Kconfig"

# Storage
source "$(BSP_TOP)drivers/mmc/Kconfig"
source "$(BSP_TOP)drivers/ufs/Kconfig"
source "$(BSP_TOP)modules/nand/Kconfig"
source "$(BSP_TOP)drivers/mtd/Kconfig"
source "$(BSP_TOP)drivers/redeposit/Kconfig"

# Graphics
source "$(BSP_TOP)drivers/video/Kconfig"
source "$(BSP_TOP)drivers/g2d/Kconfig"
source "$(BSP_TOP)drivers/di/Kconfig"
source "$(BSP_TOP)drivers/vin/Kconfig"
source "$(BSP_TOP)drivers/vfe/Kconfig"
source "$(BSP_TOP)drivers/tvd/Kconfig"
source "$(BSP_TOP)drivers/drm/Kconfig"
source "$(BSP_TOP)drivers/gpu/Kconfig"
source "$(BSP_TOP)drivers/car_reverse/car_reverse_2_0/Kconfig"
source "$(BSP_TOP)drivers/car_reverse/car_reverse_amp/Kconfig"
source "$(BSP_TOP)drivers/tvin/Kconfig"

# Multi-Media
source "$(BSP_TOP)drivers/ve/Kconfig"
source "$(BSP_TOP)drivers/rt-media/Kconfig"

# Audio
source "$(BSP_TOP)drivers/sound/Kconfig"

# Security
source "$(BSP_TOP)drivers/ce/Kconfig"
source "$(BSP_TOP)drivers/smc/Kconfig"
source "$(BSP_TOP)drivers/sid/Kconfig"
source "$(BSP_TOP)drivers/secure_storage/Kconfig"
source "$(BSP_TOP)drivers/drm_heap/Kconfig"

# I/O Connectivity
source "$(BSP_TOP)drivers/wupio/Kconfig"
source "$(BSP_TOP)drivers/pcie/Kconfig"
source "$(BSP_TOP)drivers/phy/Kconfig"
source "$(BSP_TOP)drivers/emac/Kconfig"
source "$(BSP_TOP)drivers/gmac/Kconfig"
source "$(BSP_TOP)drivers/stmmac/Kconfig"
source "$(BSP_TOP)drivers/usb/Kconfig"
source "$(BSP_TOP)drivers/twi/Kconfig"
source "$(BSP_TOP)drivers/spi/Kconfig"
source "$(BSP_TOP)drivers/spi-ng/Kconfig"
source "$(BSP_TOP)drivers/ledc/Kconfig"
source "$(BSP_TOP)drivers/pwm/Kconfig"
source "$(BSP_TOP)drivers/ir-tx/Kconfig"
source "$(BSP_TOP)drivers/ir-rx/Kconfig"
source "$(BSP_TOP)drivers/gpadc/Kconfig"
source "$(BSP_TOP)drivers/lradc/Kconfig"
source "$(BSP_TOP)drivers/rtp/Kconfig"
source "$(BSP_TOP)drivers/input/Kconfig"
source "$(BSP_TOP)drivers/ata/Kconfig"
source "$(BSP_TOP)drivers/smartcard/Kconfig"
source "$(BSP_TOP)drivers/wiegand/Kconfig"
source "$(BSP_TOP)drivers/iio/Kconfig"

# Wireless
source "$(BSP_TOP)drivers/net/Kconfig"
source "$(BSP_TOP)drivers/bluetooth/Kconfig"

# Power Management
source "$(BSP_TOP)drivers/irqchip/Kconfig"
source "$(BSP_TOP)drivers/standby/Kconfig"
source "$(BSP_TOP)drivers/thermal/Kconfig"
source "$(BSP_TOP)drivers/nvmem/Kconfig"
source "$(BSP_TOP)drivers/pm_domain/Kconfig"
source "$(BSP_TOP)drivers/power/Kconfig"
source "$(BSP_TOP)drivers/powercap/Kconfig"
source "$(BSP_TOP)drivers/cpufreq/Kconfig"
source "$(BSP_TOP)drivers/devfreq/Kconfig"
source "$(BSP_TOP)drivers/dsufreq/Kconfig"
source "$(BSP_TOP)drivers/riscv_pm/Kconfig"

# AMP/XPU
source "$(BSP_TOP)drivers/amp_timestamp/Kconfig"
source "$(BSP_TOP)drivers/msgbox/Kconfig"
source "$(BSP_TOP)drivers/hwspinlock/Kconfig"
source "$(BSP_TOP)drivers/remoteproc/Kconfig"
source "$(BSP_TOP)drivers/rpmsg/Kconfig"
source "$(BSP_TOP)drivers/rpbuf/Kconfig"
source "$(BSP_TOP)drivers/npu/Kconfig"

# Hyper
source "$(BSP_TOP)drivers/hyper/Kconfig"

# Misc
source "$(BSP_TOP)drivers/misc/Kconfig"
source "$(BSP_TOP)drivers/vendor_hooks/Kconfig"
source "$(BSP_TOP)drivers/aw_trace/Kconfig"
source "$(BSP_TOP)drivers/touch_boost/Kconfig"

# Debugging
source "$(BSP_TOP)drivers/crashdump/Kconfig"
source "$(BSP_TOP)drivers/jtag/Kconfig"
source "$(BSP_TOP)drivers/debug/Kconfig"

# pstore
source "$(BSP_TOP)drivers/pstore/Kconfig"

# FS
source "$(BSP_TOP)drivers/fs/Kconfig"

#andes adaptor
source "$(BSP_TOP)drivers/andes_adaptor/Kconfig"

#carveout
source "$(BSP_TOP)drivers/dma-buf/Kconfig"

source "$(BSP_TOP)drivers/staging/android/ion/heaps/Kconfig"

#cpu ecc
source "$(BSP_TOP)drivers/cpu_ecc/Kconfig"

#lbc
source "$(BSP_TOP)drivers/lbc/Kconfig"
#sched
source "$(BSP_TOP)drivers/sched/Kconfig"

#sram ecc
source "$(BSP_TOP)drivers/sram_ecc/Kconfig"

#motor and motor-limiter
source "$(BSP_TOP)drivers/motor/Kconfig"
source "$(BSP_TOP)drivers/motor-limit/Kconfig"

endmenu
```
