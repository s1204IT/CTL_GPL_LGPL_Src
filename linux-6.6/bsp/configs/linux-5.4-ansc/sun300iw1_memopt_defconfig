## u-boot-2018/drivers/video/sunxi/disp2/disp/Kconfig
```kconfig
config DISP2_SUNXI_SUPPORT_SMBL
	bool "Support smart backlight"
	default n
	---help---
		If you want to support smart backlight, select it.

config DISP2_SUNXI_SUPPORT_ENAHNCE
	bool "Support Video Enhance Process"
	default n
	---help---
		If you want to support video enhance process, select it.

config AW_DISP2_SET_CLK_BY_IC_VERSION
       bool "set the de clock by the ic version"
       default y
       help
               Select it to enable this feature.

config PLL_RATE_AUTO_ADJUST
	bool "Automatically adjust PLL frequency by clock framework"
	default n
	help
		Do not adjust pll rate in disp dirver, clk framework do this work for us.

config AW_DISP2_SUNXI_SUPPORT_LBC
	bool "Support lbc"
	default n
	---help---
		If you want to support lbc, select it.

config AW_DISP2_SUNXI_SUPPORT_TFBC
	bool "Support tfbc"
	default n
	---help---
		If you want to support lbc, select it.

config AW_DISP2_SUNXI_SUPPORT_AFBC
	bool "Support afbc"
	default n
	---help---
		If you want to support afbc, select it.
```
