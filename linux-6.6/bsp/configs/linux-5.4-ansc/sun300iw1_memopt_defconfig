## linux-6.6/bsp/drivers/andes_adaptor/Kconfig
```kconfig
# SPDX-License-Identifier: GPL-2.0-only
# Generic Trusted Execution Environment Configuration

menu "AW andes adaption"

config AW_ANDES_DMA_ADAPT
	bool "andes dma adapter"

if AW_ANDES_DMA_ADAPT

config FORCE_MAX_ZONEORDER
	int "Maximum zone order"
	default "9"
	help
	  The kernel memory allocator divides physically contiguous memory
	  blocks into "zones", where each zone is a power of two number of
	  pages.  This option selects the largest power of two that the kernel
	  keeps in the memory allocator.  If you need to allocate very large
	  blocks of physically contiguous memory, then you may need to
	  increase this value.

	  This config option is actually maximum order plus one. For example,
	  a value of 11 means that the largest free memory block is 2^10 pages.

choice
	prompt "adapter type"
	default AW_ANDES_DMA_OPS

config AW_ANDES_NO_DIRECT_DMA
	bool "direct dma api"
	#prohibit default non-cache alloc
	select ARCH_HAS_UNCACHED_SEGMENT
	select ARCH_HAS_DMA_COHERENT_TO_PFN

config AW_ANDES_DMA_OPS
	bool "overwrite dma ops"
	depends on DMA_CMA
	help
	 "overwrite default andes dummy dma ops for drivers"


endchoice
endif

config AW_ANDES_CMA_NON_CACHE
	depends on AW_BSP
	depends on PMA
	depends on DMA_CMA
	bool "set cma memory non_cache for devices"
	default n
	help
	  This help non-cache memory using with andes platform

endmenu
```

## linux-6.6/bsp/drivers/input/ctp/focaltech_hd_spi_touch/Kconfig
```kconfig
#
# Focaltech Touchscreen Spi driver configuration
#

config TOUCHSCREEN_FTS_SPI
    tristate "Focaltech Touchscreen spi interface"
    default n
    help
      Say Y here if you have Focaltech spi touch panel.
      If unsure, say N.
```

## linux-6.6/bsp/drivers/input/ctp/gslx680new/Kconfig
```kconfig
#
#  Touchscreen driver configuration
#
config  TOUCHSCREEN_GSLX680NEW
	tristate  "gslX680NEW touchscreen driver"
	depends on INPUT && I2C
	default n
	help
	  gsl168X, gsl268X, gsl368X touchscreen new driver, optimize anti-shake
```

## linux-6.6/bsp/drivers/input/sensor/Kconfig
```kconfig
# SPDX-License-Identifier: GPL-2.0
#
# Makefile for the sensor drivers.
#
# Each configuration option enables a list of files.


menuconfig AW_INPUT_SENSOR
    bool "Sensor Input Device Support"
    help
      Say Y here, and a list of supported sensor will be displayed.
      This option doesn't affect the kernel.

      If unsure, say Y.

if AW_INPUT_SENSOR

source "$(BSP_TOP)drivers/input/sensor/sc7a20/Kconfig"
source "$(BSP_TOP)drivers/input/sensor/stk3x1x/Kconfig"
source "$(BSP_TOP)drivers/input/sensor/mir3da/Kconfig"
source "$(BSP_TOP)drivers/input/sensor/msa/Kconfig"
source "$(BSP_TOP)drivers/input/sensor/mmc5603/Kconfig"
source "$(BSP_TOP)drivers/input/sensor/bmi323/Kconfig"
source "$(BSP_TOP)drivers/input/sensor/qmi8658/Kconfig"
source "$(BSP_TOP)drivers/input/sensor/qma6100p/Kconfig"
source "$(BSP_TOP)drivers/input/sensor/stk342x/Kconfig"
source "$(BSP_TOP)drivers/input/sensor/icm42607/Kconfig"
source "$(BSP_TOP)drivers/input/sensor/af6133e/Kconfig"

endif
```

## linux-6.6/bsp/drivers/input/sensor/af6133e/Kconfig
```kconfig
config SENSOR_AF6133E
    tristate "AF6133E Magnetometer driver support"
    depends on I2C
    default n
    help
        If you say yes here you get support for the AF6133E Magnetometer Sensor.
```

## linux-6.6/bsp/drivers/input/sensor/icm42607/Kconfig
```kconfig
# SPDX-License-Identifier: GPL-2.0
#
# Kconfig for QST sensor driver.
#

config SENSORS_ICM42607
        tristate "ICM42607 3-Axis Orientation/Motion Detection Sensor Support"
        select I2C
        depends on AW_INPUT_SENSOR
        default n
        help
          If you say yes here you get support for the Freescale 3-Axis
          Orientation/Motion Detection Sensor.
```

## linux-6.6/bsp/drivers/net/wireless/v821_smac/Kconfig
```kconfig
config V821_SMAC_WLAN
	tristate "v821 linux mac WLAN support"
	default n
	select CFG80211
	select AVERAGE
	select CRYPTO
	select CRYPTO_ARC4
	help
	  To compile this code as a module, choose M here.


if V821_SMAC_WLAN

choice XRADIO_CHIP_V821_SMAC
	prompt "Xradio chip"
        help
		Specify the xradio chip.
config USE_V821_SIP_WIFI_T
	bool "enable v821 sip wifi"
	help
		if use v821 sip wifi, please select this.

config XR819_OR_XR819S_WLAN_T
	bool "enable xr819/xr819s wlan"
	help
		if don't use v821 sip wifi, please select this.


endchoice
endif
```

## linux-6.6/bsp/drivers/riscv_pm/Kconfig
```kconfig
# SPDX-License-Identifier: GPL-2.0-only
#
# Allwinner sunXi SoC drivers
#

menu "RISCV suspend Drivers"
	depends on AW_BSP

config AW_RISCV_SUSPEND
	tristate "Allwinner sunxi riscv suspend support"
	default n
	select HARDIRQS_SW_RESEND
	select ARCH_SUSPEND_POSSIBLE

config AW_ANDES_STANDBY_DEBUG
	tristate "Andes sunxi Standby Debugging Driver"
	depends on AW_RISCV_SUSPEND && PM && RISCV && PLAT_AE350
	default y
	help
	  Say y here if you want to support standby debug module.
	  The standby debug module is used to debug system suspend.
	  When in doubt, say "Y".

endmenu
```

## linux-6.6/bsp/drivers/touch_boost/Kconfig
```kconfig
# SPDX-License-Identifier: GPL-2.0-only
menu "Touch Boost Drivers"
	depends on AW_BSP

config AW_TOUCH_BOOST
       tristate "Allwinner touch boost Support"
       depends on AW_BSP && CPU_FREQ
       default n
       help
	 Support touch boost driver.If you need boost cpufreq when you
	 touch the touchscreen,say Yes to support this feature.

config AW_AMU_CPUFREQ
       tristate "Allwinner AMU(Acitivity monitor unit) cpufreq "
       depends on AW_BSP && CPU_FREQ
       default n
       help
	 Support aw amu cpufreq.If the cpu support amu(eg,A76),you could
	 enable this feature.The driver would monitor cpu cycles/instructions
	 and mem stall cycles, which could reduce cpu frequency for lower power
endmenu
```

## linux-6.6/bsp/drivers/video/sunxi/disp2/disp/Kconfig
```kconfig
# SPDX-License-Identifier: GPL-2.0-or-later
config AW_DISP2_SUPPORT_SMBL
	bool "Support smart backlight"
	default y
	help
		If you want to support smart backlight, select it.

config AW_DISP2_SUPPORT_ENAHNCE
	bool "Support Video Enhance Process"
	default y
	help
		If you want to support video enhance process, select it.

config AW_DISP2_DEVICE_OFF_ON_RELEASE
	bool "Clear all layers and turn off display device on /dev/disp release"
	default n
	help
		Select it to enable this feature.

config AW_DISP2_SET_CLK_BY_IC_VERSION
	bool "Set the de clock by the ic version"
	default y
	help
		Select it to enable this feature.

config AW_DISP2_OFFLINE_MODE
	bool "Offline mode is used to avoid screen blur caused by bandwidth"
	default n
	help
		Select it to enable this feature.

config PLL_RATE_AUTO_ADJUST
	bool "Automatically adjust PLL frequency by clock framework"
	default n
	help
		Do not adjust pll rate in disp dirver, clk framework do this work for us.

config AW_DISP2_SUPPORT_CAPTURE
	bool "Enable disp capture feature"
	default y
	help
		Select it to enable enable disp capture feature

config AW_DISP2_SUPPORT_DUMP_REG
	bool "Support dump de register through syfs"
	default n
	help
		Support dump de register through syfs.
```

## linux-6.6/bsp/drivers/vin/Kconfig
```kconfig
# SPDX-License-Identifier: GPL-2.0-only
menu "VIN (camera) Drivers"
	depends on AW_BSP

config AW_VIDEO_SUNXI_VIN
       tristate "sunxi video input (camera csi/mipi isp vipp) driver"
	   select MEDIA_SUPPORT
       default n

config AW_SENSOR_POWER
       tristate "sensor power in front of vin"
       depends on AW_VIDEO_SUNXI_VIN
       default n
config CSI_VIN
	tristate "v4l2 new driver for SUNXI"
	depends on AW_VIDEO_SUNXI_VIN
	default m
	select VIDEOBUF2_DMA_CONTIG

config ENABLE_SENSOR_FLIP_OPTION
	bool "select sensor flip to replace vipp flip"
	depends on AW_VIDEO_SUNXI_VIN
	default n
	help
	   you cant flip in vipp when you select LBC format,
	   so you can enable it to active sensor flip operation.

config VIDEO_SUNXI_VIN_SPECIAL
	bool "special function for vin"
	depends on AW_VIDEO_SUNXI_VIN
	default n
	help
	   if say Y, some special function will be support for
           some scence, such as fast car reverse and so on.

config CSI_CCI
	tristate "use cci function"
	depends on AW_VIDEO_SUNXI_VIN
	default n
	help
		CCI is a hardware module in CSI. you can make it to
		be cci or i2c in the system.

if CSI_CCI
source "$(BSP_TOP)drivers/vin/vin-cci/Kconfig"
endif

config FLASH
	tristate "use flash module"
	depends on AW_VIDEO_SUNXI_VIN
	default m

config ACTUATOR
	tristate "use actuator module"
	depends on AW_VIDEO_SUNXI_VIN
	default n

if ACTUATOR
source "$(BSP_TOP)drivers/vin/modules/actuator/Kconfig"
endif

config SENSOR_LIST
	tristate "sensor list for adaptive"
	depends on AW_VIDEO_SUNXI_VIN
	default m

config BUF_AUTO_UPDATE
	bool "buf addr update for hardware"
	depends on AW_VIDEO_SUNXI_VIN
	default n

config BUF_GET_FRAME_DONE
	bool "buf get in frame done"
	depends on AW_VIDEO_SUNXI_VIN
	default n

config VIN_LOG
	bool "use vin log for debug"
	depends on AW_VIDEO_SUNXI_VIN
        depends on DYNAMIC_DEBUG
	default y

config PIPELINE_RESET
	bool "use pipeline reset when timeout"
	depends on AW_VIDEO_SUNXI_VIN
	default n

config MULTI_FRAME
	bool "multi-frame interrupt mode"
	depends on AW_VIDEO_SUNXI_VIN
	default n

config SUPPORT_ISP_TDM
	bool "use isp for time sharing multiplex"
	depends on AW_VIDEO_SUNXI_VIN
	default n

config TDM_LBC_EN
	bool "tdm reduces buf size by compression"
	depends on SUPPORT_ISP_TDM
	default n

config TDM_ONE_BUFFER
	bool "tdm use one buffer mode"
	depends on SUPPORT_ISP_TDM
	default n
	help
		need ensure sensor vbland > 20%

config TDM_ONE_BUFFER_WITH_TWORX
	bool "tdm use one buffer mode with two tdm_rx run"
	depends on TDM_ONE_BUFFER
	default n

config TDM_OFFLINE_HANDLE_RAW
	bool "tdm receive raw data to user and than get it from user, finally return to isp"
	depends on SUPPORT_ISP_TDM
	default n

config AVG_TDM_FIFO
	bool "set the tdm four channels fifo the same"
	depends on SUPPORT_ISP_TDM
	default n

choice
	depends on AW_VIDEO_SUNXI_VIN
	prompt "select rgb mode"
	default VIPP_YUV2RGB

config SENSOR_RGB
	bool "sensor output rgb"

config VIPP_YUV2RGB
	bool "vipp yuv to rgb"

endchoice

config MULTI_FRM_MERGE_INT
	bool "multi-frame image merge interrupt"
	depends on AW_VIDEO_SUNXI_VIN
	default n

config DEF_MEDIA_LINK
	bool "set default media link"
	depends on AW_VIDEO_SUNXI_VIN
	default n

config DISPPLAY_SYNC
	bool "use one buffer for delay display"
	depends on AW_VIDEO_SUNXI_VIN
	default n

choice
	depends on AW_VIDEO_SUNXI_VIN
	prompt "select memory alloc mode"
	default VIN_CMA

config VIN_CMA
	bool "use CMA for memory alloc"

config VIN_IOMMU
	bool "use IOMMU for memory alloc"

config VIN_USE_ION_SIZE_POOL_HEAP
	bool "use memory pool for memory alloc"

endchoice

config D3D
	bool "ISP 3D denoise module"
	depends on AW_VIDEO_SUNXI_VIN
	default n

config D3D_LTF_EN
	bool "ISP 3D denoise long time frame"
	depends on D3D
	depends on AW_VIDEO_SUNXI_VIN
	default n

choice
	depends on D3D
	prompt "select d3d mode"
	default D3D_PKG_MODE

config D3D_PKG_MODE
	bool "use d3d pkg mode"

config D3D_LBC_MODE
	bool "use d3d lbc mode"
endchoice

config D3D_COMPRESS_EN
	bool "ISP 3D denoise reduces buf size by compression"
	depends on AW_VIDEO_SUNXI_VIN
	depends on D3D
	depends on D3D_LBC_MODE
	default	n

config WDR
	bool "ISP WDR module"
	depends on AW_VIDEO_SUNXI_VIN
	default n

config WDR_COMPRESS_EN
	bool "ISP WDR reduces buf size by compression"
	depends on AW_VIDEO_SUNXI_VIN
	depends on WDR
	default	n

config FRAMEDONE_TWO_BUFFER
	bool "use two buffer in bk frame done interrupt"
	depends on AW_VIDEO_SUNXI_VIN
	default	n

config SAME_I2C
	bool "sensor same i2c addr"
	depends on AW_VIDEO_SUNXI_VIN
	default y

config VIN_SDRAM_DFS
	bool "use vin sdram dfs"
	depends on AW_VIDEO_SUNXI_VIN
	default n

config CSI_SDRAM_DFS_TEST
	bool "sensor first debug for sdram dfs"
	depends on VIN_SDRAM_DFS
	default n

config ISP_SERVER_MELIS
	bool "use ISP server from melis"
	depends on AW_VIDEO_SUNXI_VIN
	default n

config ISP_SPECIAL_LDCI
	bool "use isp ldci on fastboot"
	depends on ISP_SERVER_MELIS
	default n

config RPMSG_SEND_ISP_PARA
	bool "use rpmsg send isp para to rtos"
	depends on ISP_SERVER_MELIS
	default n

config VIN_INIT_MELIS
	bool "vin and isp init in melis"
	depends on AW_VIDEO_SUNXI_VIN
	default n

config ISP0_THRESHOLD_PARAM_OFFSET
	int "isp0 threshold param offset(sector)"
	default 111
	help
	  This section is located between boot0 and uboot.
	  Must ensure that the offset of this section is not less than the size of boot0.
	  The sizeof of the boot0&uboot reserved section is defined at the 'flashmap'
	  dts node in uboot-board.dts.

config ISP1_THRESHOLD_PARAM_OFFSET
	int "isp1 threshold param offset(sector)"
	default 119
	help
	  This section is located between boot0 and uboot.
	  Must ensure that the offset of this section is not less than the size of boot0.
	  The sizeof of the boot0&uboot reserved section is defined at the 'flashmap'
	  dts node in uboot-board.dts.

config VIN_THRESHOLD_PARAM_SIZE
	hex "vin threshold param size"
	default 0x200

config RV_RUN_CAR_REVERSE
	bool "special function for vin used on rv"
	depends on VIN_INIT_MELIS && VIDEO_SUNXI_VIN_SPECIAL
	default n

config ISP_REG_DEBUG_NODE
	bool "open isp register debug node"
	depends on AW_VIDEO_SUNXI_VIN
	default n

source "$(BSP_TOP)drivers/vin/modules/sensor/Kconfig"

endmenu
```

## linux-6.6/bsp/drivers/wupio/Kconfig
```kconfig
# SPDX-License-Identifier: GPL-2.0-only

menu "WUPIO Drivers"
	depends on AW_BSP

config AW_WUPIO
	tristate "WUPIO Support for Allwinner SoCs"
	depends on AW_BSP
	help
	  If you say Y here, you will get support for the WUPIO found on
	  Allwinner SoCs.

endmenu
```

## u-boot-2018/configs/sun60iw2p1_defconfig
```kconfig
CONFIG_ARM=y
CONFIG_ARM_SMCCC=y
CONFIG_SYS_TEXT_BASE=0x4A000000
CONFIG_SUNXI_SECURE_BOOT=y
CONFIG_SUNXI_WDT_V2=y
CONFIG_MACH_SUN60IW2=y
CONFIG_DEFAULT_DEVICE_TREE="sun60iw2p1-soc-system"
# CONFIG_SYS_MALLOC_CLEAR_ON_INIT is not set
CONFIG_PHYS_64BIT=y
CONFIG_ANDROID_BOOT_IMAGE=y
CONFIG_CONSOLE_MUX=y
CONFIG_SUNXI_KEYBOX=y
CONFIG_SUNXI_SERIAL=y
CONFIG_ANDROID_AB=y
CONFIG_SUNXI_MAC=y
CONFIG_SUNXI_USER_KEY=y
CONFIG_SUNXI_DRM_SUPPORT=y
CONFIG_SUNXI_NECESSARY_REPLACE_FDT=y
CONFIG_SUNXI_FPGA_PLATFORM=y
CONFIG_CMD_PART=y
CONFIG_CMD_SUNXI_MEMTEST=y
CONFIG_CLK_SUNXI=y
CONFIG_SUNXI_DMA=y
CONFIG_AW_GPIO_V3=y
CONFIG_MMC=y
CONFIG_PWM_NOT_USE=y
CONFIG_SUNXI_SDMMC=y
CONFIG_SUNXI_CE_30=y
CONFIG_SUNXI_SPRITE=y
CONFIG_SUNXI_SPRITE_CARTOON=y
```

## u-boot-2018/drivers/ddr/Kconfig
```kconfig
menu "DDR Support"

source "drivers/ddr/altera/Kconfig"
source "drivers/ddr/sunxi/Kconfig"

endmenu
```

## u-boot-2018/drivers/ddr/sunxi/Kconfig
```kconfig
config SUNXI_DRAM_SELECT_RECORD
	bool "record dram para select to cmdline"
	depends on SUNXI_GPADC
	help
		when enable, record dram para select to cmdline.
```

## u-boot-2018/drivers/phy_key/Kconfig
```kconfig
menuconfig SUNXI_PHY_KEY
	bool "Sunxi phy-key divice support"

if SUNXI_PHY_KEY

config SUNXI_GPADC_KEY
	bool "Support sunxi gpkey devices"
	help
	  Enable support for sunxi gpkey devices.

config SUNXI_LRADC_KEY
	bool "Support sunxi lrkey devices"
	help
	  Enable support for sunxi lrkey devices.

config SUNXI_GPIO_KEY
	bool "Support sunxi gpiokey devices"
	help
	  Enable support for sunxi gpiokey devices.

endif
```
