## linux-6.6/bsp/configs/linux-5.4-ansc/rv32_min_defconfig
```kconfig
CONFIG_SYSVIPC=y
CONFIG_NO_HZ_IDLE=y
CONFIG_HIGH_RES_TIMERS=y
CONFIG_IKCONFIG=y
CONFIG_IKCONFIG_PROC=y
CONFIG_BLK_DEV_INITRD=y
CONFIG_EXPERT=y
CONFIG_ARCH_RV32I=y
CONFIG_SMP=y
CONFIG_HIGHMEM=y
CONFIG_CMDLINE="earlyprintk=sunxi-uart,0x42500000 loglevel=8 initcall_debug=1 console=ttyAS0 init=/init"
CONFIG_MODULES=y
CONFIG_MODULE_UNLOAD=y
CONFIG_AW_BSP=y
# CONFIG_AW_DDR_CCU is not set
# CONFIG_AW_INPUT_SENSORINIT is not set
CONFIG_DEVTMPFS=y
CONFIG_DEVTMPFS_MOUNT=y
# CONFIG_INPUT_MOUSE is not set
CONFIG_SERIAL_EARLYCON_RISCV_SBI=y
CONFIG_HVC_RISCV_SBI=y
# CONFIG_HW_RANDOM is not set
CONFIG_SIFIVE_PLIC=y
CONFIG_TMPFS=y
CONFIG_NLS=y
CONFIG_CRYPTO=y
CONFIG_PRINTK_TIME=y
CONFIG_DEBUG_FS=y
# CONFIG_RCU_TRACE is not set
CONFIG_BLK_DEV_INITRD=y
CONFIG_INITRAMFS_SOURCE="./../../../../bsp/ramfs/ramfs_riscv32"
```

## linux-6.6/bsp/drivers/amp_timestamp/Kconfig
```kconfig
# SPDX-License-Identifier: GPL-2.0-only
#
# Allwinner AMP timestamp driver.
#

config AW_AMP_TIMESTAMP
	tristate "AMP Timestamp Driver"
	depends on AW_BSP
	default n
	help
	  Allwinner AMP timestamp driver, it provide timestamp
	  with same timebase on AMP situation.
```

## linux-6.6/bsp/drivers/cpu_ecc/Kconfig
```kconfig
# SPDX-License-Identifier: GPL-2.0-only

menu "sunxi cpu ecc Drivers"
	depends on AW_BSP

config AW_CPU_ECC
	tristate "CPU ECC  Support for Allwinner SoCs"
	help
	  To compile this driver as a module, choose M here: the
	  module will be called sunxi_cpu_ecc.

config AW_CPU_ECC_TEST
       bool "CPU ECC testing"
       depends on AW_CPU_ECC
       default n
       help
	 Enables a suite of cpu ecc unit testing.
endmenu
```

## linux-6.6/bsp/drivers/dma-buf/Kconfig
```kconfig
config AW_DMABUF_HEAPS_CARVEOUT
	bool "Carveout Heaps"
	depends on DMABUF_HEAPS
	help
	  Choose this option to enable the carveout dmabuf heap. The carveout
	  heap is backed by pages from reserved memory regions flagged as
	  exportable. If in doubt, say Y.
```

## linux-6.6/bsp/drivers/drm_heap/Kconfig
```kconfig
# SPDX-License-Identifier: GPL-2.0-only
# Generic Trusted Execution Environment Configuration

menu "DRM HEAP Drivers"
	depends on AW_BSP

config AW_DRM_HEAP
	tristate "Allwinner drm heap"
	default n
	depends on AW_SMC
	select TEE
	help
	  This implements a interface for sunxi drm management

endmenu
```

## linux-6.6/bsp/drivers/dumpreg/Kconfig
```kconfig
# SPDX-License-Identifier: GPL-2.0-only

menu "Dump-Reg Drivers"
	depends on AW_BSP

config AW_DUMP_REG
	tristate "Dump-Reg Support for Allwinner SoCs"
	depends on AW_BSP
	default y
	help
	  Say y here if you want to support sunxi dump-reg module.
	  The dump-reg module is used to dump registers of any device.
	  When in doubt, say "Y".

config AW_DUMPREG_DYNAMIC_DEBUG
        bool "Enable dumpreg dynamic debug"
        depends on AW_DUMP_REG
        default y
        help
          Enable dumpreg dynamic debug
endmenu
```

## linux-6.6/bsp/drivers/hyper/Kconfig
```kconfig
# SPDX-License-Identifier: GPL-2.0-only
#
# hyper system configuration
#

menu "Kylo Hyper System"
	depends on AW_BSP


config SUPPORT_HYPER
       tristate "Allwinner Hyper Support"
       depends on AW_BSP
       help
         Support for the Kylo hyper system.

         If unsure, say N here.

if SUPPORT_HYPER

choice
       prompt "hyper os type"
       default HYPER_HOST_OS

config HYPER_HOST_OS
       bool "hyper host os"

config HYPER_GUEST_OS
       bool "hyper guest os"
endchoice

endif # AW_IOMMU_DEBUG

endmenu
```

## linux-6.6/bsp/drivers/iio/Kconfig
```kconfig
# SPDX-License-Identifier: GPL-2.0-only
#
# Industrial I/O subsystem configuration
#

menu "Industrial I/O support"

source "$(BSP_TOP)drivers/iio/temperature/Kconfig"

endmenu
```

## linux-6.6/bsp/drivers/iio/temperature/Kconfig
```kconfig
# SPDX-License-Identifier: GPL-2.0-only
#
# Temperature sensor drivers
#
menu "Temperature sensors"

config DS18B20
		tristate "DS18B20 Programmable Resolution 1-Wire Digital Thermometer"
		depends on IIO && OF_GPIO
		help
		  If you say yes here you get support for DS18B20
		  thermometer sensor chip connected via 1-Wire GPIO.

		  This driver can also be build as a module. If so, the module
		  will be called ds18b20.

endmenu
```

## linux-6.6/bsp/drivers/input/ctp/betterlife_ts/Kconfig
```kconfig
#
#  Touchscreen driver configuration
#
config TOUCHSCREEN_BETTERLIFE_TS
       tristate  "betterlisfe touchscreen driver"      
       depends on INPUT && I2C
       default n
       help
         betterlisfe touch panel  
		 
config TOUCHSCREEN_BETTERLIFE_TS_FACTORY_TEST
       tristate  "betterlisfe touchscreen factory test module"      
       depends on TOUCHSCREEN_BETTERLIFE_TS
       default n
       help
         betterlisfe touch panel factory test module
         
```

## linux-6.6/bsp/drivers/input/ctp/jdchipset/Kconfig
```kconfig
#
# Touchscreen driver configuration
#
config TOUCHSCREEN_JDCHIPSET
	tristate "Jadard touch chipset"
	depends on I2C
	help
	  Say Y here if you have a Jadard chipset touchscreen.

	  If unsure, say N.
```

## linux-6.6/bsp/drivers/input/ctp/jdchipset/Kconfig.bak
```kconfig
#
# Touchscreen driver configuration
#
config TOUCHSCREEN_JADARD_CHIPSET
	bool "Jadard touch chipset"
	depends on I2C
	help
	  Say Y here if you have a Jadard chipset touchscreen.

	  If unsure, say N.
```

## linux-6.6/bsp/drivers/input/sensor/qma6100p/Kconfig
```kconfig
config SENSORS_QMA6100P
        tristate "QMA6100P 3-Axis Orientation/Motion Detection Sensor Support"
        select I2C
        depends on AW_INPUT_SENSOR
        default n
        help
          If you say yes here you get support for the Freescale 3-Axis
          Orientation/Motion Detection Sensor.
```

## linux-6.6/bsp/drivers/input/sensor/stk342x/Kconfig
```kconfig
config SENSORS_STK342X
    tristate "stl342x Light driver support"
    depends on I2C
    default n
    help
        This driver implements light device driver.
        It communicates with a back-end in another domain.
        To compile this driver as a module, choose M here: the
            module will be called xen-kbdfront.
```

## linux-6.6/bsp/drivers/lbc/Kconfig
```kconfig
# SPDX-License-Identifier: GPL-2.0-only
menu "Bus Drivers"
	depends on AW_BSP

config AW_LBC
	tristate "Local Bus Ctrl Support for Allwinner SoCs"
	depends on AW_BSP
	help
	  Support the Local Bus Ctrl driver for Allwinner platforms.

endmenu
```

## linux-6.6/bsp/drivers/lradc/Kconfig
```kconfig
# SPDX-License-Identifier: GPL-2.0-only
#
# LRADC drivers configuration
#

menu "Low Rate ADC Drivers"
	depends on AW_BSP


config AW_LRADC
	tristate "Keyboard Support for Allwinner SoCs"
	select INPUT_EVDEV
	help
	  Say Y here to enable the ADC keyboard, support 7 keys at most.

config AW_LRADC_DYNAMIC_DEBUG
        bool "Enable lradc dynamic debug"
        depends on AW_LRADC
        default y
        help
          Enable lradc dynamic debug

endmenu
```

## linux-6.6/bsp/drivers/misc/sunxi-gpio-motor/Kconfig
```kconfig
# SPDX-License-Identifier: GPL-2.0
#
# Allwinner GPIO 2803 Motor driver.
#

config AW_GPIO_MOTOR_2803
  tristate "Allwinner gpio motor 2803 driver"
  depends on AW_PINCTRL
  help
    allwinner gpio motor 2803 driver
```

## linux-6.6/bsp/drivers/motor-limit/Kconfig
```kconfig
# SPDX-License-Identifier: GPL-2.0-only
menu "GPIO Motor support"

config MOTOR_LIMITER
	tristate "Motor Limiter Driver"
	help
	  Motor Limiter Driver

endmenu
```

## linux-6.6/bsp/drivers/motor/Kconfig
```kconfig
# SPDX-License-Identifier: GPL-2.0-only
menu "GPIO Motor support"

config MOTOR_CONTROL
	tristate "Motor Control Driver"
	help
	  Motor Control Driver

endmenu
```

## linux-6.6/bsp/drivers/mtd/awnand/rawnand/Kconfig
```kconfig
#
# SPDX-License-Identifier: GPL-2.0+
# (C) Copyright 2020 - 2021
# Allwinner Technology Co., Ltd. <www.allwinnertech.com>
# cuizhikui <cuizhikui@allwinnertech.com>

menuconfig AW_MTD_RAWNAND
	tristate "Allwinner MTD RAWNAND Device Support"
	depends on AW_MTD
	depends on !SUNXI_NAND
	select AW_RAWNAND_SECURE_STORAGE
	select MTD
	select MTD_UBI
	help
	  Enables support for RAWNAND Flash chips on Allwinner SoCs.
	  It's different with Allwinner's privately nand driver that it use
	  ubi system rather than Allwinner's NFTL.

if AW_MTD_RAWNAND

config AW_RAWNAND_PSTORE_MTD_PART
	bool "create pstore mtd partition for aw ubi rawnand"
	depends on AW_MTD_RAWNAND
	select MTD_PSTORE
	help
	  Whether create pstore mtd partition, which is need by pstroe-blk.
	  If you want linux kernel dump log to spinand when oops/panic, you
	  should create pstreo mtd partition by this configure.

	  If unsure, say no.

config AW_RAWNAND_BURN_CHECK_BOOT0
	bool "upload boot0 to check after download boot0 img"
	depends on AW_MTD_RAWNAND

config AW_RAWNAND_BURN_CHECK_UBOOT
	bool "upload uboot to check after download uboot img"
	depends on AW_MTD_RAWNAND

choice
	prompt "RAWNAND DMA method Select"
	depends on AW_MTD_RAWNAND
	default AW_MTD_RAWNAND_USE_MBUS_DMA

	config AW_MTD_RAWNAND_USE_MBUS_DMA
		bool "raw nand transfer data with mbus dma (internal dma)"
		help
		  This option is to let Rawnand use MBUS DMA (that is, internal DMA) to transfer data.
		  If unsure, say Y.

	config AW_MTD_RAWNAND_USE_GENERAL_DMA
		bool "raw nand transfer data with general dma"
		help
		  This option is to let Rawnand use general DMA to transfer data.
		  If unsure, say N.
endchoice

endif
```

## linux-6.6/bsp/drivers/net/Kconfig
```kconfig
# SPDX-License-Identifier: GPL-2.0

menu "Network Device Drivers"
	depends on NET

if NETDEVICES

source "$(BSP_TOP)drivers/net/wireless/Kconfig"
source "$(BSP_TOP)drivers/net/phy/Kconfig"

endif

endmenu
```

## linux-6.6/bsp/drivers/net/phy/Kconfig
```kconfig
# SPDX-License-Identifier: GPL-2.0-only
#
# PHY Layer Configuration
#

menu "PHY"
	depends on PHYLIB

config MAXIO_PHY
	tristate "MAXIO PHYs"
	help
	Supports the Maxio MAExxxx PHY.

endmenu
```

## linux-6.6/bsp/drivers/net/wireless/aic_usb_sdio/Kconfig
```kconfig
config AIC_USB_SDIO_WLAN_SUPPORT
	bool "AIC usb sdio wireless Support"
	default n
	help
	  This is support for aic wireless chip.

choice
	prompt "Enable Chip Interface"
	depends on AIC_USB_SDIO_WLAN_SUPPORT
	help
		Enable Chip Interface.
config AIC_USB_SDIO_INTF_SDIO
		bool "SDIO interface support"
		depends on AIC_USB_SDIO_WLAN_SUPPORT && MMC
config AIC_USB_SDIO_INTF_USB
		bool "USB interface support"
		depends on AIC_USB_SDIO_WLAN_SUPPORT && USB
endchoice

choice
	prompt "Choice host wake IRQ type"
	default AIC_USB_SDIO_IRQ_ACTIVE_UNSET
	help
		Choice host wake IRQ type.
config AIC_USB_SDIO_IRQ_ACTIVE_UNSET
		bool "UNSET IRQ type use default config"
config AIC_USB_SDIO_IRQ_ACTIVE_HIGH
		bool "host wake High level trigger"
config AIC_USB_SDIO_IRQ_ACTIVE_RISING
		bool "host wake RISING trigger"
config AIC_USB_SDIO_IRQ_ACTIVE_LOW
		bool "host wake Low level trigger"
config AIC_USB_SDIO_IRQ_ACTIVE_FALLING
		bool "host wake FALLING trigger"
endchoice

config USB_MSG_EP
	bool "Enable usb message endpoint"
	default y if AIC_USB_SDIO_INTF_USB
	depends on AIC_USB_SDIO_INTF_USB
	help
	  This would enable usb message endpoint

if AIC_USB_SDIO_WLAN_SUPPORT
source "$(BSP_TOP)drivers/net/wireless/aic_usb_sdio/aic8800_fdrv/Kconfig"
source "$(BSP_TOP)drivers/net/wireless/aic_usb_sdio/aic8800_btlpm/Kconfig"
endif

if AIC_USB_SDIO_INTF_USB
source "$(BSP_TOP)drivers/net/wireless/aic_usb_sdio/aic8800_btusb/Kconfig"
endif
```

## linux-6.6/bsp/drivers/net/wireless/v821_fmac/Kconfig
```kconfig
# SPDX-License-Identifier: GPL-2.0-only
config V821_FMAC_WLAN
	tristate "v821 dual protocol stack support"
	default n
	help
	  To compile this code as a module, choose M here.

if V821_FMAC_WLAN

config V821_FMAC_RPMSG
	tristate "Support RPMSG platforms"
	depends on V821_FMAC_WLAN && RPMSG
	help
	  Enable support for the XRADIO connected via an RPMSG bus.

config V821_FMAC_SDIO
	tristate "Support SDIO platforms"
	depends on V821_FMAC_WLAN && MMC
	help
	  Enable support for the XRADIO connected via an SDIO bus.
	  By default this driver only supports the Sagrad XR819S/XR821 EVK
	  and similar designs that utilize a hardware reset circuit. To
	  support different XRADIO SDIO designs you will need to override
	  the default platform data by calling xradio_sdio_set_platform_data()
	  in your board setup file.

config V821_FMAC_SPI
	tristate "Support SPI platforms"
	depends on V821_FMAC_WLAN && SPI
	help
	  Enables support for the XRADIO connected via a SPI bus.  You will
	  need to add appropriate platform data glue in your board setup
	  file.

endif
```

## linux-6.6/bsp/drivers/powercap/Kconfig
```kconfig
# SPDX-License-Identifier: GPL-2.0-only
#
# Devfreq device configuration
#

menu "DTPM Device Drivers"
	depends on AW_BSP

config AW_DTPM
	tristate "SUNXI DTPM Driver"
	select DTPM
	select DTPM_CPU

	help
	  Describe the hierarchy for the Dynamic Thermal Power Management tree
	  on this platform. That will create all the power capping capable
	  devices.

	  If in doubt, say N.
endmenu
```
