## linux-6.6/bsp/drivers/remoteproc/Kconfig
```kconfig
# SPDX-License-Identifier: GPL-2.0-only
#
# Allwinner remoteproc driver.
#
menu "Remoteproc drivers"
	depends on AW_BSP

config AW_REMOTEPROC
	tristate "Remoteproc Support for Allwinner SoCs"
	depends on AW_BSP
	select REMOTEPROC
	select MAILBOX
	help
	  allwinner

config AW_RPMSG_RX_IN_KTHREAD
	bool "Receiving rpmsg in realtime kthread"
	depends on AW_REMOTEPROC
	default y
	help
	  Receiving rpmsg data in the realtime kernel thread.
	  It can improve the priority of rpmsg handling
	  and avoid the virtio buffer is exhausted.
	  Otherwise it will use workqueue to receive
	  rpmsg data.

config AW_RPROC_FAST_BOOT
	bool "Allwinner remoteproc fast boot mode support"
	depends on AW_REMOTEPROC
	default n
	help
	  Say y here to support Allwinner remote processor
	  fast boot mode.
	  This mode can speed up init operation.

config AW_RPROC_ENHANCED_TRACE
	bool "Allwinner remoteproc enhanced trace"
	depends on AW_REMOTEPROC
	default y
	help
	  Say y here to support Allwinner remote processor
	  enhanced trace function.

config AW_RPROC_SUBDEV
	bool "Allwinner remoteproc subdev support"
	depends on AW_REMOTEPROC
	default n
	help
	  Say y here to support subdev for Allwinner remote processor.

config AW_RPROC_SUBDEV_WDT
	bool "Allwinner remoteproc wdt subdev support"
	depends on AW_RPROC_SUBDEV
	default n
	help
	  Say y here to support wdt subdev for Allwinner remote processor.

config AW_RPROC_SUBDEV_RSC_HELPER
	bool "Allwinner remoteproc rsc helper subdev support"
	depends on AW_RPROC_SUBDEV
	default n
	help
	  Say y here to support rsc helper subdev for Allwinner remote processor.

config AW_RPROC_SUBDEV_STANDBY
	bool "Allwinner standby subdev support"
	depends on AW_RPROC_SUBDEV && AW_REMOTEPROC_E907_STANDBY
	default n
	help
	  Say y here to support standby subdev for Allwinner remote processor.

config AW_RPROC_SUBDEV_ECC
	bool "Allwinner remoteproc ecc subdev support"
	depends on AW_RPROC_SUBDEV && AW_REMOTEPROC_E907_ECC_ENABLE
	default n
	help
	  Say y here to support ecc subdev for Allwinner remote processor.

config AW_RPROC_USER_RESOURCE
	bool "Allwinner remoteproc handle rsc of user data"
	depends on AW_RPROC_SUBDEV_RSC_HELPER
	default n
	help
	  Say y here to support handle the rsc of user data .

config SUNXI_RPROC_SHARE_IRQ
	bool "SUNXI remote share irq support"
	depends on AW_REMOTEPROC
	default n
	help
	  Say y here to support SUNXI remote share irq driver.

config AW_REMOTEPROC_HIFI4_BOOT
	tristate "Allwinner remoteproc hifi4 boot"
	depends on AW_REMOTEPROC
	help
	  Say y here to support Allwinner SOC processors hifi4 via
	  remote processor framework.

config AW_REMOTEPROC_E906_BOOT
	tristate "Allwinner remoteproc e906 boot"
	depends on AW_REMOTEPROC
	help
	  Say y here to support Allwinner SOC processors e906 via
	  remote processor framework.

config AW_REMOTEPROC_E906_STANDBY
	bool "Allwinner remoteproc e906 standby"
	default n
	depends on AW_REMOTEPROC_E906_BOOT
	help
	  Say y here to support Allwinner SOC processors e906 standby

config AW_REMOTEPROC_E907_BOOT
	tristate "Allwinner remoteproc e907 boot"
	depends on AW_REMOTEPROC
	default n
	help
	  Say y here to support boot Allwinner SOC processors e907 via
	  remote processor framework.

config AW_REMOTEPROC_E907_STANDBY
	bool "Allwinner remoteproc e907 standby"
	default n
	depends on AW_REMOTEPROC_E907_BOOT
	help
	  Say y here to support Allwinner SOC processors e907 standby

config AW_REMOTEPROC_E907_STOP_NOTIFY
	bool "Allwinner remoteproc e907 stop notify"
	default n
	depends on AW_REMOTEPROC_E907_BOOT
	help
	  Say y here to support Allwinner SOC processors e907 stop notify

config AW_REMOTEPROC_E907_ECC_ENABLE
	tristate "Allwinner remoteproc e90X ECC funtion enable"
	depends on AW_REMOTEPROC && AW_REMOTEPROC_E907_BOOT
	default n
	help
	  Say y here to support e907 ecc function

config AW_REMOTEPROC_ARM64_BOOT
	tristate "Allwinner remoteproc arm64 boot"
	depends on AW_REMOTEPROC
	default n
	help
	  Say y here to support Allwinner SOC processors arm64 via
	  remote processor framework.

config AW_REMOTEPROC_DECOMPRESS_FW
	tristate "Allwinner remoteproc decompress firmware from partition"
	depends on AW_REMOTEPROC
	default n
	help
	  Say y here to support Allwinner decompress firmware

config AW_REMOTEPROC_DECOMPRESS_FW_SIZE
	hex "Allwinner remoteproc decompress firmware size"
	depends on AW_REMOTEPROC_DECOMPRESS_FW
	default 0x200000
	help
	  set decompress elf size

config AW_REMOTEPROC_USE_UNLZMA
	tristate "Allwinner remoteproc decompress use lzma lib"
	depends on AW_REMOTEPROC && AW_REMOTEPROC_DECOMPRESS_FW
	select DECOMPRESS_LZMA
	default n
	help
	  Say y here to support unlzma

config AW_REMOTEPROC_USE_UNGZIP
	tristate "Allwinner remoteproc decompress use gzip lib"
	depends on AW_REMOTEPROC && AW_REMOTEPROC_DECOMPRESS_FW
	select DECOMPRESS_GZIP
	default n
	help
	  Say y here to support ungzip

config AW_REMOTEPROC_USE_UNLZ4
	tristate "Allwinner remoteproc decompress use lz4 lib"
	depends on AW_REMOTEPROC && AW_REMOTEPROC_DECOMPRESS_FW
	select DECOMPRESS_LZ4
	default n
	help
	  Say y here to support unlz4

endmenu
```

## linux-6.6/bsp/drivers/rt-media/Kconfig
```kconfig
menu "rt-media"

config VIDEO_RT_MEDIA
	tristate "sunxi rt-media support"
    select DMA_SHARED_BUFFER
	default n
	help
	  This is the driver for sunxi video decoder, including h264/
	  mpeg4/mpeg2/vc1/rmvb.
	  To compile this driver as a module, choose M here: the
	  module will be called cedar_dev.

choice
	prompt "Default sunxi rt singel sensor"
	default RT_MEDIA_SINGEL_SENSOR
	help
	  Select sunxi rt singel sensor that will be used by default.

	config RT_MEDIA_SINGEL_SENSOR
		bool "sunxi rt singel sensor"
		depends on (VIDEO_RT_MEDIA)
		help
		  enable singel sensor setup in kernel stage.

	config RT_MEDIA_DUAL_SENSOR
		bool "sunxi rt dual sensor"
		depends on (VIDEO_RT_MEDIA)
		help
		  enable dual sensor setup in kernel stage.

	config RT_MEDIA_THREE_SENSOR
		bool "sunxi rt three sensor"
		depends on (VIDEO_RT_MEDIA)
		help
		  enable three sensor setup in kernel stage.
endchoice

config RT_MEDIA_CDC_LOG_LEVEL
	int "set cdc log level, 2:verbose 3:debug 4:info 5:warn 6:err"
	depends on (VIDEO_RT_MEDIA)
	default 3
	help
	  set cdc log level, 2:verbose 3:debug 4:info 5:warn 6:err

config RT_MEDIA_SETUP_RECORDER_IN_KERNEL
	bool "setup recorder in kernel"
	depends on (VIDEO_RT_MEDIA)
	default y
	help
	  y is enable encoder start in kernel poweron state.

endmenu
```

## linux-6.6/bsp/drivers/rtp/Kconfig
```kconfig
# SPDX-License-Identifier: GPL-2.0-only
#
# resistive touch panel driver configuration
#
menu "Resistive Touch Panel Drivers"
	depends on AW_BSP

config AW_RTP
	tristate "Resistive Touch Panel Support for Allwinner SoCs"
	select INPUT_EVDEV
        default n
	help
	  This enables the resistive touch panel controller(TPADC)
	  on Allwinner SoCs.

config AW_TPADC_DYNAMIC_DEBUG
        bool "Enable tpadc dynamic debug"
        depends on AW_RTP
        default y
        help
          Enable tpadc dynamic debug

config RTP_USED_AS_NORMAL_ADC
	bool "enable rtp is used as normal adc"
	depends on AW_RTP
	default n
	help
	  Enable rtp is used as normal ADC
endmenu
```

## linux-6.6/bsp/drivers/sched/Kconfig
```kconfig
# SPDX-License-Identifier: GPL-2.0-only
config AW_SCHEDULER
        tristate "Allwinner scheduler tunning"
        depends on ANDROID_VENDOR_HOOKS
        default n
        help
         If you don't sure, please select N
```

## linux-6.6/bsp/drivers/smc/Kconfig
```kconfig
# SPDX-License-Identifier: GPL-2.0-only

menu "SMC Drivers"
	depends on AW_BSP

config AW_SYS_INFO
	tristate "Allwinner System Info Driver"
	default n
	help
	  This driver is used for query system information.
	  If you don't know whether need it, please select y.

config AW_SMC
	tristate "Allwinner SMC Interfaces"
	default n
	depends on ARM || ARM64
	help
	  This driver support smc call interfaces depended on
	  monitor/aft/SecureOs. If you don't know whether need
	  it, please select y.

config AW_SBI
	tristate "Allwinner SBI Interfaces"
	depends on RISCV_SBI
	default n
	help
	  This driver support ecall interfaces depended on
	  opensbi. If you don't know whether need it, please select y.

config AW_SECURITY_SYSFS
	tristate "Allwinner Security Sysfs"
	depends on AW_SMC
	default n

endmenu
```

## linux-6.6/bsp/drivers/sram_ecc/Kconfig
```kconfig
# SPDX-License-Identifier: GPL-2.0-only

menu "sunxi sram ecc Drivers"
	depends on AW_BSP

config AW_SRAM_ECC
	tristate "Sram ecc Support for Allwinner SoCs"
	help
	  To compile this driver as a module, choose M here: the
	  module will be called sunxi_sram_ecc.

config AW_SRAM_ECC_TEST
       bool "SRAM ECC testing"
       depends on AW_SRAM_ECC
       default n
       help
	 Enables a suite of sram ecc unit testing.
endmenu
```

## linux-6.6/bsp/drivers/staging/android/ion/heaps/Kconfig
```kconfig
# SPDX-License-Identifier: GPL-2.0
config ION_SIZE_POOL_HEAP
	tristate "Ion size_pool heap"
	depends on ION
```

## linux-6.6/bsp/drivers/timer/Kconfig
```kconfig
# SPDX-License-Identifier: GPL-2.0-only
menu "Timer Drivers"
	depends on GENERIC_CLOCKEVENTS
	depends on AW_BSP

config AW_TIMER
	tristate "Timer support for Allwinner SoCs"
	depends on HAS_IOMEM
	select CLKSRC_MMIO
	select TIMER_OF
	help
	  Enables support for the Sun4i timer.

config AW_TIMER_SUN50I
	tristate "Timer support for Allwinner Sun50i SoCs"
	depends on HAS_IOMEM
	select CLKSRC_MMIO
	select TIMER_OF
	help
	  Enables support for the Sun50i timer.

config AW_TIMER_SWAP_IVH_CVL_SPACE
	bool "change IVH reg and CVL reg space"
	depends on AW_TIMER_SUN50I
	default n
	help
	  If the layout of the IVH reg and CVL reg registers is opposite to that of the
	  AW1890, this configuration needs to be enabled for adjustment.

config AW_TIMER_DYNAMIC_DEBUG
	bool "Enable timer dynamic debug"
	depends on AW_TIMER || AW_TIMER_SUN50I
	default y
	help
	  Enable timer dynamic debug

config AW_ALTERNATIVE_HSTIMER
	tristate "Hstimer support for Allwinner SoCs"
	depends on HAS_IOMEM
	default n
	help
	  Support the use of hstimer as a timing or counting in kernel mode, Only modify
	  sunxi-alternative-hstimer.h if adapt other platform.

endmenu
```

## linux-6.6/bsp/drivers/tvin/Kconfig
```kconfig
menu "TVIN Drivers"
config AW_HRC
        tristate "HRC Support for Allwinner SoCs"
        default n
        select MEDIA_SUPPORT
        select VIDEOBUF2_DMA_CONTIG
        select VIDEO_V4L2_SUBDEV_API
        help
          Support for sunxi platform HDMI Rx Capture engine,
          this module is used to capture HDMI RX images to DDR
          for image display or other image processing work.

          To compile this driver as a module, choose M here.
          If you are not sure whether the platform supports it, choose N here.

config AW_VIDEO_SUNXI_HDMIRX
	tristate "sunxi hdmirx driver"
	default n
	help
          Support for sunxi platform HDMI Rx ,
          this module is used to send signal and buffer to hrc

          To compile this driver as a module, choose M here.
          If you are not sure whether the platform supports it, choose N here.

config AW_VIDEO_SUNXI_HDMIRX_CEC
	bool "HDMIRX CEC"
	depends on (AW_VIDEO_SUNXI_HDMIRX)
	default n
	select CEC_CORE
	select CEC_NOTIFIER
	help
          To compile this driver as a module, choose M here.
          If you are not sure whether the platform supports it, choose N here.

menuconfig AW_VIDEO_SUNXI_HDMIRX_LOG_BUFFER
        bool "HDMIRX Log Buffer"
        depends on (AW_VIDEO_SUNXI_HDMIRX)
        default y
        help
          Say Y here if you want to enable hdmirx log buffer.
          Say N here if you want to disable hdmirx log buffer.
          If unsure, say N
endmenu
```

## linux-6.6/bsp/drivers/wiegand/Kconfig
```kconfig
# SPDX-License-Identifier: GPL-2.0-only
#
# WIEGAND drivers configuration
#
menu "Wiegand Drivers"
	depends on AW_BSP

config SUNXI_WIEGAND
	tristate "allwinnertech Wiegand driver"
	select INPUT_EVDEV
	default n
	help
	  Choose Y to enable wiegand driver

config AW_WIEGAND_DYNAMIC_DEBUG
        bool "Enable wiegand dynamic debug"
        depends on SUNXI_WIEGAND
        default y
        help
          Enable wiegand dynamic debug
endmenu
```

## linux-6.6/bsp/lib/Kconfig
```kconfig
menu "Library routines"

config LIBM
        tristate "support softfloat"
        default n
        help
         support softfloat in kernel

endmenu
```
