## linux-6.6/bsp/platform/Kconfig
```kconfig
# SPDX-License-Identifier: GPL-2.0-only

source "$(BSP_TOP)platform/Kconfig.common"

menu "Platform Information"

config AW_BSP
	bool "Allwinner Platform"
	select ARCH_SUNXI
	select ARCH_HAS_RESET_CONTROLLER
	select GENERIC_IRQ_CHIP
	select PINCTRL
	select RESET_CONTROLLER
	help
	  This enables support for Allwinner sunxi based SoCs like the A64.

choice
	prompt "Kernel Type"
	depends on AW_BSP
	default AW_KERNEL_AOSP
	help
	  Select the type/source of kernel you are using.

config AW_KERNEL_AOSP
	bool "AOSP"
	depends on AW_BSP
	help
	  AOSP linux kernel from Google

config AW_KERNEL_ORIGIN
	bool "Origin"
	depends on AW_BSP
	help
	  Origin linux kernel from mainline/LTS.
endchoice  # Kernel Type

choice
	prompt "SoC Family"
	default ARCH_SUN8I  if ARM
	default ARCH_SUN50I if ARM64
	default ARCH_SUN300I if RISCV
	depends on AW_BSP
	help
	  Select the Family for SoC

config ARCH_SUN8I
	bool "SUN8I"
	depends on AW_BSP && ARM
	help
	  Allwinner SUN8I SoC Family

config ARCH_SUN20I
	bool "SUN20I"
	depends on AW_BSP && RISCV
	help
	  Allwinner SUN20I SoC Family

config ARCH_SUN50I
	bool "SUN50I"
	depends on AW_BSP
	#select xxx if ARM
	#select xxx64 if ARM64
	help
	  Allwinner SUN50I SoC Family

config ARCH_SUN55I
	bool "SUN55I"
	depends on AW_BSP
	help
	  Allwinner SUN55I SoC Family

config ARCH_SUN60I
	bool "SUN60I"
	depends on AW_BSP && ARM64
	help
	  Allwinner SUN60I SoC Family

config ARCH_SUN65I
	bool "SUN65I"
	depends on AW_BSP && ARM64
	help
	  Allwinner SUN65I SoC Family

config ARCH_SUN251I
	bool "SUN251I"
	depends on AW_BSP && RISCV
	help
	  Allwinner SUN251I SoC Family

config ARCH_SUN300I
	bool "SUN300I"
	depends on AW_BSP && RISCV
	help
	  Allwinner SUN300I SoC Family

config ARCH_SUN252I
	bool "SUN252I"
	depends on AW_BSP && RISCV
	help
	  Allwinner SUN252I SoC Family

endchoice  # SoC Family

choice
	prompt "SoC Wafer"
	default ARCH_SUN50IW10
	depends on AW_BSP
	help
	  Select the wafer

config ARCH_SUN8IW11
	bool "SUN8IW11"
	depends on ARCH_SUN8I
	help
	  Support for Allwinner SUN8IW11 SoC

config ARCH_SUN8IW17
	bool "SUN8IW17"
	depends on ARCH_SUN8I
	help
	  Support for Allwinner SUN8IW17 SoC

config ARCH_SUN8IW18
	bool "SUN8IW18"
	depends on ARCH_SUN8I
	help
	  Support for Allwinner SUN8IW18 SoC

config ARCH_SUN8IW20
	bool "SUN8IW20"
	depends on ARCH_SUN8I
	help
	  Support for Allwinner SUN8IW20 SoC

config ARCH_SUN8IW21
	bool "SUN8IW21"
	depends on ARCH_SUN8I
	help
	  Support for Allwinner SUN8IW21 SoC

config ARCH_SUN20IW1
	bool "SUN20IW1"
	depends on ARCH_SUN20I
	help
	  Support for Allwinner SUN20IW1 SoC

config ARCH_SUN50IW9
	bool "SUN50IW9"
	depends on ARCH_SUN50I
	help
	  Support for Allwinner SUN50IW9 SoC

config ARCH_SUN50IW10
	bool "SUN50IW10"
	depends on ARCH_SUN50I
	help
	  Support for Allwinner SUN50IW10 SoC

config ARCH_SUN50IW12
	bool "SUN50IW12"
	depends on ARCH_SUN50I
	help
	  Support for Allwinner SUN50IW12 SoC

config ARCH_SUN50IW15
	bool "SUN50IW15"
	depends on ARCH_SUN50I
	help
	  Support for Allwinner SUN50IW15 SoC

config ARCH_SUN55IW3
	bool "SUN55IW3"
	depends on ARCH_SUN55I
	help
	  Support for Allwinner SUN55IW3 SoC

config ARCH_SUN55IW5
	bool "SUN55IW5"
	depends on ARCH_SUN55I
	help
	  Support for Allwinner SUN55IW5 SoC

config ARCH_SUN55IW6
	bool "SUN55IW6"
	depends on ARCH_SUN55I
	help
	  Support for Allwinner SUN55IW6 SoC

config ARCH_SUN60IW1
	bool "SUN60IW1"
	depends on ARCH_SUN60I
	help
	  Support for Allwinner SUN60IW1 SoC

config ARCH_SUN60IW2
	bool "SUN60IW2"
	depends on ARCH_SUN60I
	help
	  Support for Allwinner SUN60IW2 SoC

config ARCH_SUN65IW1
	bool "SUN65IW1"
	depends on ARCH_SUN65I
	help
	  Support for Allwinner SUN60IW3 SoC

config ARCH_SUN251IW1
	bool "SUN251IW1"
	depends on ARCH_SUN251I
	help
	  Support for Allwinner SUN251IW1 SoC

config ARCH_SUN300IW1
	bool "SUN300IW1"
	depends on ARCH_SUN300I
	help
	  Support for Allwinner SUN300IW1 SoC

config ARCH_SUN252IW1
	bool "SUN252IW1"
	depends on ARCH_SUN252I
	help
	  Support for Allwinner SUN252IW1 SoC

endchoice  # SoC Wafer

choice
	prompt "SoC Package"
	depends on AW_BSP
	help
	  Select the SoC

config ARCH_SUN8IW11P1
	depends on ARCH_SUN8IW11
	bool "Allwinner SUN8IW11P1"

config ARCH_SUN8IW17P1
	depends on ARCH_SUN8IW17
	bool "Allwinner SUN8IW17P1"

config ARCH_SUN8IW18P1
	depends on ARCH_SUN8IW18
	bool "Allwinner SUN8IW18P1"

config ARCH_SUN8IW20P1
	depends on ARCH_SUN8IW20
	bool "Allwinner SUN8IW20P1"

config ARCH_SUN8IW21P1
	depends on ARCH_SUN8IW21
	bool "Allwinner SUN8IW21P1"

config ARCH_SUN20IW1P1
	depends on ARCH_SUN20IW1
	bool "Allwinner SUN20IW1P1"

config ARCH_SUN50IW9P1
	depends on ARCH_SUN50IW9
	bool "Allwinner SUN50IW9P1"

config ARCH_SUN50IW10P1
	depends on ARCH_SUN50IW10
	bool "Allwinner SUN50IW10P1"

config ARCH_SUN50IW12P1
	depends on ARCH_SUN50IW12
	bool "Allwinner SUN50IW12P1"

config ARCH_SUN50IW15P1
	depends on ARCH_SUN50IW15
	bool "Allwinner SUN50IW15P1"

config ARCH_SUN55IW3P1
	depends on ARCH_SUN55IW3
	bool "Allwinner SUN55IW3P1"

config ARCH_SUN55IW5P1
	depends on ARCH_SUN55IW5
	bool "Allwinner SUN55IW5P1"

config ARCH_SUN55IW6P1
	depends on ARCH_SUN55IW6
	bool "Allwinner SUN55IW6P1"

config ARCH_SUN60IW1P1
	depends on ARCH_SUN60IW1
	bool "Allwinner SUN60IW1P1"

config ARCH_SUN60IW2P1
	depends on ARCH_SUN60IW2
	bool "Allwinner SUN60IW2P1"

config ARCH_SUN65IW1P1
	depends on ARCH_SUN65IW1
	bool "Allwinner SUN65IW1P1"

config ARCH_SUN251IW1P1
	depends on ARCH_SUN251IW1
	bool "Allwinner SUN251IW1P1"

config ARCH_SUN300IW1P1
	depends on ARCH_SUN300IW1
	bool "Allwinner SUN300IW1P1"

config ARCH_SUN252IW1P1
	depends on ARCH_SUN252IW1
	bool "Allwinner SUN252IW1P1"

endchoice  # SoC Package

choice
	prompt "Board Type"
	depends on AW_BSP
	default AW_FPGA_BOARD

config AW_FPGA_BOARD
	bool "FPGA Board"
	depends on AW_BSP
	help
	  Support for Allwinner FPGA board

config AW_IC_BOARD
	bool "IC Board"
	depends on AW_BSP
	help
	  Support for Allwinner IC board
endchoice  # Board Type

choice
	prompt "FPGA Board Type"
	depends on AW_FPGA_BOARD
	default AW_FPGA_S4

config AW_FPGA_S4
	bool "FPGA S4 Board"
	help
	  Support for Allwinner FPGA S4 board

config AW_FPGA_V7
	bool "FPGA V7 Board"
	help
	  Support for Allwinner FPGA V7 board

config AW_FPGA_UV440
	bool "FPGA UV440 Board"
	help
	  Support for Allwinner FPGA UV440 board

endchoice  # FPGA board Type

config AW_SOC_NAME
	string "SoC Name"
	default ""
	depends on AW_BSP
	help
	  Used by sysfs: /sys/.../sysinfo

endmenu  # Platform Information
```

## linux-6.6/bsp/platform/Kconfig.turbo
```kconfig
# SPDX-License-Identifier: GPL-2.0-only
menu "Allwinner's Turbo Options"
	depends on AW_BSP

config AW_BSP_LOWMEM
	bool "Lowmem config in tiny memory platform"
	default n
	depends on AW_BSP

config AW_IPC_FASTBOOT
	bool "fastboot config for aw ipc platform"
	depends on ARCH_SUN300IW1
	default n

endmenu
```

## u-boot-2018/drivers/hwspinlock/Kconfig
```kconfig
menu "HW SPINLOCK  Support"
config HWSPINLOCK
    bool "enable sunxi hwspinlock driver"
        default n

config CMD_SUNXI_HWSPINLOCK
    bool "enable sunxi hwspinlock cmd"
        default n

endmenu
```

## u-boot-2018/drivers/mtd/awnand/Kconfig
```kconfig
config AW_MTD_SPINAND
	tristate "Allwinner MTD SPINAND Device Support"
	depends on ARCH_SUNXI
	select AW_SPINAND_PHYSICAL_LAYER
	select AW_SPINAND_NONSTANDARD_SPI_DRIVER
	select MTD_UBI
	select MTD_DEVICE
	select MTD_PARTITIONS
	select MTD_CMD_MTDPARTS
	select MTD_CMD_UBIFS
	select CMD_UBI
	select RBTREE
	select LZO
	help
	  Enables support for SPINAND Flash chips on Allwinner SoCs.
	  It's different with Allwinner's privately nand driver that it use
	  ubi system rather than Allwinner's NFTL.

config AW_MTD_RAWNAND
	tristate "Allwinner MTD RAWNAND(SLC) Device Support"
	depends on ARCH_SUNXI
	select SUNXI_UBIFS
	select SUNXI_NAND
	select SUNXI_COMM_NAND_V1
	select MTD_DEVICE
	select CMD_MTDPARTS
	select CMD_UBIFS
	select CMD_UBI
	select RBTREE
	select LZO
	help
	  Enables support for RAWNAND Flash chips on Allwinner SoCs.
	  It's different with Allwinner's privately nand driver that it use
	  ubi system rather than Allwinner's NFTL.

config RAW_KERNEL
	bool "Kernel images are stored on physical partitions"
	help
	  Enables support kernel images are stored on physical partitions.

config KERNEL_SIZE_BYTE
	int "Kernel image size(Byte)"
	depends on RAW_KERNEL
	default 0
	help
	  To accurately read the complete kernel image, you need to set
	  the kernel image size (in bytes) when using the RAW-boot function.

config SUNXI_PRIVATE_UBIDEV
	bool "Open private ubidev"
	help
	  Open the private ubidev partition, the customer can write through
	  the card to write the partition data.

config SUNXI_PRIVATE_UBIDEV_BLKS
	int "Private ubidev partition size (number of blocks)"
	depends on SUNXI_PRIVATE_UBIDEV
	default 0
	help
	  The size of the private partition, aligned by block.

config SIMULATE_MULTIPLANE
	bool "enable simulate multiplane"
	default n
	help
	  spinand do not support multiplane. In order to adapt to aw nand
	  we simulate multiplane. If set, the common physical layer should
	  merge two continuous physical block to 'super block' for logical
	  layer.

	  Merge pages in two adjacent blocks with the same page num to super
	  page. Merge adjacent blocks to super block.

	  *   phy-block0   phy-block1    = super block 0
	  * |------------|------------|
	  * | phy-page 0 | phy-page 0 |  = super page 0 on super block 0
	  * | phy-page 1 | phy-page 1 |  = super page 1 on super block 0
	  * |     ...    |     ...    |
	  * |------------|------------|

	  If unsure, say Y.

if AW_MTD_SPINAND
source "drivers/mtd/awnand/spinand/Kconfig"
endif

if AW_MTD_RAWNAND
source "drivers/mtd/awnand/rawnand/Kconfig"
endif
```

## u-boot-2018/drivers/nsi/Kconfig
```kconfig
menu "sunxi NSI support"

config SUNXI_NSI_DRV
	bool "support sunxi nsi"
	default n

endmenu
```

## u-boot-2018/drivers/riscv/Kconfig
```kconfig
config BOOT_RISCV
	bool "Support RISCV"
	default n

config RISCV_UPDATA_IRQ_TAB
	bool "Support RISCV share irq table updata"
	depends on BOOT_RISCV
	default n

config RISCV_UPDATA_IRQ_TAB_DEBUG
	bool "Support RISCV share irq table updata debug log"
	depends on RISCV_UPDATA_IRQ_TAB
	default n
```

## u-boot-2018/drivers/sbi/Kconfig
```kconfig
menu "Sunxi sbi ecall driver support"

config SUNXI_SBI_ECALL
	bool "use sbi ecall api"
	depends on RISCV
	---help---
	Select this to use opensbi ecall api.

endmenu
```

## u-boot-2018/drivers/video/sunxi/disp2/edp2/panels/Kconfig
```kconfig
# SPDX-License-Identifier: GPL-2.0-or-later
config EDP2_SUPPORT_VVX10T025J00_2560X1600
    tristate "eDP panel support VVX10T025J00_2560X1600"
    depends on (EDP2_DISP2_SUNXI)
    default n
    help
        If you want to support VVX10T025J00_2560X1600 panel for edp2 driver, select it.

config EDP2_SUPPORT_LM116X001A40_1920X1080
    tristate "eDP panel support LM116X001A40_1920X1080"
    depends on (EDP2_DISP2_SUNXI)
    default n
    help
        If you want to support LM116X001A40_1920X1080 panel for edp2 driver, select it.

config EDP2_SUPPORT_GENERAL_PANEL
    tristate "eDP panel support general_panel"
    depends on (EDP2_DISP2_SUNXI)
    default n
    help
        If you want to support general panel for edp2 driver, select it.
```

## u-boot-2018/sprite/Kconfig
```kconfig
menuconfig SUNXI_SPRITE
	bool "Sunxi Sprite support"
	select SUNXI_FLASH
	help
	  Enable support for sunxi efex devices. 

if SUNXI_SPRITE

config SUNXI_SECURE_STORAGE
	bool "Sunxi Sprite Secure Storage"
	help
	  Enable supprot for sunxi secure storage

config SECURE_STORAGE_KEY_HUK
	bool "Sunxi Secure Storage select huk to crypto"
	depends on SUNXI_SECURE_STORAGE
	default n
	help
	  sunxi secure storage select huk to crypto

config SUNXI_SPRITE_CARTOON
	bool "Sunxi Sprite cartoon support"
	select SUNXI_FLASH
	default n
	help
	  Enable support for sunxi Sprite cartoon(display)

config SUNXI_SPRITE_CARTOON_CHAR
	bool "Sunxi Sprite cartoon char support"
	select SUNXI_FLASH
	depends on SUNXI_SPRITE_CARTOON
	help
	  Enable support for sunxi Sprite cartoon char(display)

config SUNXI_SPRITE_LED
	bool "Sunxi Sprite LED support"
	default n
	help
	  Enable support for sunxi Sprite LED(display)

config SUNXI_SPRITE_RECOVERY
	bool "Sunxi Sprite recovery support"
	depends on SUNXI_SDMMC
	default y
	help
	  Enable support for sunxi Sprite recovery

config SUNXI_AUTO_UPDATE
	bool "Sunxi auto update support"
	depends on MMC || USB
	default n
	help
	  Enable support for sunxi auto update

config SUNXI_MELIS_AUTO_UPDATE
	bool "Sunxi melis auto update support"
	depends on MMC || USB
	default n
	help
	  Enable support for sunxi melis auto update

choice
	depends on SUNXI_AUTO_UPDATE
	prompt "select update form sdcard or usb disk"
	default UPDATE_FROM_SDCARD

config UPDATE_FROM_SDCARD
	bool "img from sdcard"

config UPDATE_FROM_USB
	bool "img from usb disk"

endchoice

config SUNXI_DIGEST_TEST
	bool "Sunxi digest test support"
	default n
	help
	  Enable support for sunxi digest test

config SUNXI_UPDATE_GPT

	bool "Sunxi auto gpt support"
	default n
	help
	  Enable support for sunxi gpt update

config FW_BURN_UDISK_MIN_SIZE
	hex "UDISK min data length default is 0x800"
	depends on SUNXI_SPRITE || SUNXI_AUTO_UPDATE
	default 0x800
	help
	  set UDISK min data length

config SUNXI_PART_UPDATE
	bool "Sunxi part update support"
	depends on MMC
	default n
	help
	  Enable support for sunxi auto update

config SUNXI_BOOT_PARAM
	bool "enable sunxi boot param"
	help
		store startup related parameters

config SUNXI_TURNNING_DRAM
	bool "SUNXI TURNNING DRAM SVAE"
	default n if SUNXI_BOOT_PARAM
	default y
	help
	  This is the SUNXI TURNNING DRAM

config SUNXI_OTA_TURNNING
	bool "SUNXI OTA TURNNING SVAE"
	depends on (SUNXI_TURNNING_FLASH || SUNXI_TURNNING_DRAM)
	# if we use this on mmc, copy0 recover must be enabled
	depends on (!SUNXI_SDMMC || (SUNXI_SDMMC && SUNXI_RECOVERY_BOOT0_COPY0))
	help
	  This is the SUNXI OTA TURNNING SAVE

endif
```
